## WaveShare/WS_147_C6_ESP/sdkconfig.defaults
```kconfig
CONFIG_SPIRAM=y
CONFIG_SPIRAM_MODE_OCT=y
CONFIG_SPIRAM_SPEED_80M=y

CONFIG_LV_USE_USER_DATA=y
CONFIG_LV_USE_CHART=y
# CONFIG_LV_USE_PERF_MONITOR is not set

CONFIG_ESPTOOLPY_FLASHSIZE_4MB=y
CONFIG_PARTITION_TABLE_CUSTOM=y
```
